## meta-hmi-custom/conf/layer.conf
```bitbake
# We have a conf and classes directory, add to BBPATH
BBPATH .= ":${LAYERDIR}"

# We have recipes-* directories, add to BBFILES
BBFILES += "${LAYERDIR}/recipes-*/*/*.bb \
	${LAYERDIR}/recipes-*/*/*.bbappend"

BBFILE_COLLECTIONS += "hmi-custom"
BBFILE_PATTERN_hmi-custom = "^${LAYERDIR}/"
BBFILE_PRIORITY_hmi-custom = "7"
```

## meta-userboard/conf/layer.conf
```bitbake
# We have a conf and classes directory, add to BBPATH
BBPATH .= ":${LAYERDIR}"

# We have recipes-* directories, add to BBFILES
BBFILES += "${LAYERDIR}/recipes-*/*/*.bb \
	${LAYERDIR}/recipes-*/*/*.bbappend"

BBFILE_COLLECTIONS += "userboard"
BBFILE_PATTERN_userboard = "^${LAYERDIR}/"
BBFILE_PRIORITY_userboard = "10"
```
